## drivers/input/keyboard/Kconfig
```kconfig
# SPDX-License-Identifier: GPL-2.0-only
#

if INPUT_KEYBOARD
config KEYBOARD_S2MPG12
       tristate "Samsung Electronics S2MPG14 Powerkey Controller"

config KEYBOARD_S2MPG14
       tristate "Samsung Electronics S2MPG14 Powerkey Controller"

endif # INPUT_KEYBOARD
```
